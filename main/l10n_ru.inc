/* English source keys -> Russian. Preserve printf types/order and symbols. */
T("Settings", "Настройки")
T("Language", "Язык")
T("Pages", "Экраны")
T("Page %d", "Экран %d")
T("Page %d%s", "Экран %d%s")
T("Map%s", "Карта%s")
T(" fields", ": поля")
T(" layout", ": макет")
T("Cell %d", "Поле %d")
T("Enable", "Включить")
T("Layout", "Макет")
T("Fields", "Поля данных")
T("Sensors", "Датчики")
T("Profile", "Профиль")
T("Lap length", "Длина круга")
T("Auto pause", "Автопауза")
T("Backlight", "Подсветка")
T("Time zone", "Часовой пояс")
T("Theme", "Тема")
T("Auto theme", "Автотема")
T("Light", "Светлая")
T("Dark", "Тёмная")
T("Map", "Карта")
T("Map layers", "Слои карты")
T("Route", "Маршрут")
T("History", "История")
T("Reset statistics", "Сброс статистики")
T("System", "Система")
T("Reset settings", "Сброс настроек")
T("Reset settings?", "Сбросить настройки?")
T("Debug log", "Журнал отладки")
T("About", "О прошивке")
T("%s open firmware\n%s\n\nESP-IDF %s\nbuilt %s\n\nheap %u KB  psram %u KB\nup %lu s", "%s: открытая прошивка\n%s\n\nESP-IDF %s\nСборка %s\n\nRAM %u КБ  PSRAM %u КБ\nРаботает %lu с")
T("Cancel", "Отмена")
T("Back", "Назад")
T("Done", "Готово")
T("None", "Нет")
T("none", "нет")
T("off", "выкл.")
T("Off", "Выкл.")
T("ok", "ОК")
T("searching", "поиск")
T("Scan finished:", "Поиск завершён:")
T("Scanning...", "Поиск...")
T("%s  %d found", "%s Найдено: %d")
T("Add sensor", "Добавить датчик")
T("Wheel", "Колесо")
T("Wheel circumference", "Окружность колеса")
T("ANT+ %s\ndevice number %u\ntransmission type %u\nstate: %s", "ANT+ %s\nНомер: %u\nТип передачи: %u\nСостояние: %s")
T("Weight", "Вес")
T("Height", "Рост")
T("Year of birth", "Год рождения")
T("Sex", "Пол")
T("Male", "Мужской")
T("Female", "Женский")
T("Max heart rate", "Макс. пульс")
T("Threshold HR", "Пороговый пульс")
T("HR zones by", "Зоны пульса от")
T("Bike weight", "Вес велосипеда")
T("Health", "Здоровье")
T("recovery", "восстановление")
T("endurance", "выносливость")
T("tempo", "темповая")
T("threshold", "пороговая")
T("maximum", "максимальная")
T("anaerobic", "анаэробная")
T("neuromusc.", "нейромышечная")
T("underweight", "дефицит")
T("normal", "норма")
T("overweight", "избыточный вес")
T("obese", "ожирение")
T("%s, %u kg, %u cm", "%s, %u кг, %u см")
T(", %d y", ", %d лет")
T("\nBMI %.1f (%s)", "\nИМТ %.1f (%s)")
T("\nBMR %d kcal/day", "\nОбмен: %d ккал/день")
T("\nMax HR %d%s, LTHR %d%s\n", "\nПульс макс. %d%s, порог %d%s\n")
T(" (est.)", " (расч.)")
T("\nHR zones, %% of %s:", "\nЗоны пульса, %% от %s:")
T("max HR", "макс. пульса")
T("\n\nPower zones, FTP %u W:", "\n\nЗоны мощности, FTP %u Вт:")
T("\n\nPower zones: set FTP", "\n\nЗоны мощности: задайте FTP")
T("Pages, profile, lap length,\ntime zone, theme and backlight\ngo back to the firmware defaults.", "Экраны, профиль и другие\nнастройки вернутся\nк исходным значениям.")
T("Power off?", "Выключить?")
T("End ride?", "Завершить?")
T("End", "Завершить")
T("START RIDE", "ПОЕХАЛИ")
T("Ride summary", "Итоги поездки")
T("USB storage", "USB-накопитель")
T("eMMC is exposed to the host.\nEject it, then reboot.", "Диск подключён к ПК.\nИзвлеките диск,\nзатем перезагрузите.")
T("Reboot", "Перезагрузка")
T("key %d", "кнопка %d")
T("key %d: start ride   key %d: status", "%d: старт   %d: состояние")
T("key %d: off   other: cancel", "%d: выкл. Остальные: отмена")
T("key %d: end   other: cancel", "%d: конец. Остальные: отмена")
T("or hold key %d", "или удерживайте кнопку %d")
T("key %d: +   key %d: -   key %d: back", "%d: +   %d: -   %d: назад")
T("LAP %lu", "КРУГ %lu")
T("no sensor data yet", "Нет данных датчиков")
T("nRF: no reply yet", "nRF: нет ответа")
T("GPS: probing baud", "GPS: поиск связи")
T("GPS: no data", "GPS: нет данных")
T("SD: not mounted", "SD: не подключена")
T("press a key...", "нажмите кнопку...")
T("touch: none", "касание: нет")
T("touch: %s", "тач: %s")
T("touch: %d,%d", "тач: %d,%d")
T("ANT: waiting for nRF", "ANT: ожидание nRF")
T("no fix", "поиск")
T("fix", "позиция")
T("GPS %s  %u/%u sats", "GPS %s  %u/%u спут.")
T("GPS %s  %u/%u sats  hdop %.1f", "GPS %s %u/%u HDOP %.1f")
T("HR --  cad --  --.- km/h", "Пульс -- Кад. -- --.- км/ч")
T("HR %s  cad %s  %s km/h", "Пульс %s Кад. %s %s км/ч")
T("Sunrise %s   Sunset %s", "Восход %s Закат %s")
T(" auto", " авто")
T(": no paired sensors", ": нет датчиков")
T("nRF ok  reason %u  fw %u.%u.%u", "nRF ОК код %u ПО %u.%u.%u")
T("%d.%02d C   %lu.%lu hPa", "%d.%02d C   %lu.%lu гПа")
T("Time", "Время")
T("Time of Day", "Время суток")
T("Session Time", "Время поездки")
T("Distance", "Расстояние")
T("Avg speed", "Ср. скорость")
T("Max speed", "Макс. скорость")
T("Avg spd", "Ср. скор.")
T("Max spd", "Макс. скор.")
T("Avg HR", "Ср. пульс")
T("Max HR", "Макс. пульс")
T("Avg cadence", "Ср. каденс")
T("Avg power", "Ср. мощность")
T("Max altitude", "Макс. высота")
T("Speed", "Скорость")
T("ANT Speed", "Скор. ANT")
T("Spd Sensor", "Датчик скор.")
T("Temp", "Температура")
T("mV", "мВ")
T("Heart Rate", "Пульс")
T("HR", "Пульс")
T("Cadence", "Каденс")
T("Power", "Мощность")
T("Altitude", "Высота")
T("Grade", "Уклон")
T("Temperature", "Температура")
T("Pressure", "Давление")
T("Min ", "Мин. ")
T("Max ", "Макс. ")
T("Avg ", "Ср. ")
T("(empty)", "(пусто)")
T("Battery", "Батарея")
T("Satellites", "Спутники")
T("Heading", "Направление")
T("Sunrise", "Восход")
T("Sunset", "Закат")
T("Sunset in", "До заката")
T("Laps", "Круги")
T("Lap", "Круг")
T("Lap Dist", "Длина круга")
T("Lap Time", "Время круга")
T("Lap Speed", "Скор. круга")
T("PreLap Time", "Время пред. круга")
T("PreLap Dist", "Длина пред. круга")
T("Route Left", "До финиша")
T("Calories", "Калории")
T("Cal Rate", "Расход энергии")
T("HR Zone", "Зона пульса")
T("%Max HR", "% макс. пульса")
T("%LTHR", "% порог. пульса")
T("Zone Time", "Время в зоне")
T("Power Zone", "Зона мощности")
T("Power/kg", "Мощность/кг")
T("Gear", "Передача")
T("Gears", "Передачи")
T("Front Gear", "Передняя звезда")
T("Gear Combo", "Звёзды")
T("Shift Batt", "Бат. перекл.")
T("Other", "Прочее")
T("Climb", "Набор")
T("Descent", "Спуск")
T("New", "Новая")
T("Good", "Хорошая")
T("Low", "Мало")
T("Crit", "Крит.")
T("Chrg", "Заряд")
T("24h", "24ч")
T("km", "км")
T("km/h", "км/ч")
T("bpm", "уд/мин")
T("rpm", "об/мин")
T("W", "Вт")
T("W/kg", "Вт/кг")
T("m", "м")
T("hPa", "гПа")
T("kcal", "ккал")
T("kcal/h", "ккал/ч")
T("%u.%u km", "%u.%u км")
T("%.1f km", "%.1f км")
T("%.1f km/h", "%.1f км/ч")
T("%u mm", "%u мм")
T("%u kg", "%u кг")
T("%u cm", "%u см")
T("%u (%d y)", "%u (%d лет)")
T("%u bpm", "%u уд/мин")
T("auto (%d)", "авто (%d)")
T("%u W", "%u Вт")
T("%uW", "%uВт")
T("%u.%u kg", "%u.%u кг")
T("%d bpm", "%d уд/мин")
T("%d rpm", "%d об/мин")
T("%d W", "%d Вт")
T("%d kcal", "%d ккал")
T("%d m", "%d м")
T("%d km", "%d км")
T("Waiting for a GPS fix", "Ожидание позиции GPS")
T("No maps in /sdcard/MAP", "Нет карт в /sdcard/MAP")
T("no position", "нет позиции")
T("power", "мощность")
T("trainer", "станок")
T("shifting", "переключатель")
T("light", "фонарь")
T("radar", "радар")
T("spd+cad", "скор.+каденс")
T("cadence", "каденс")
T("speed", "скорость")
T("cad", "кад.")
T("spd", "скор.")
T("pwr", "мощн.")
T("Motorway / trunk", "Автомагистрали")
T("Primary", "Главные дороги")
T("Secondary", "Второстепенные")
T("Tertiary", "Местные дороги")
T("Residential", "Жилые улицы")
T("Service", "Служебные проезды")
T("Pedestrian", "Пешеходные улицы")
T("Footway", "Пешеходные дорожки")
T("Path", "Тропы")
T("Track", "Грунтовые дороги")
T("Cycleway", "Велодорожки")
T("Water", "Водоёмы")
T("Coastline", "Береговая линия")
T("Land use", "Землепользование")
T("Parks / forest", "Парки и леса")
T("Buildings", "Здания")
T("Fill areas", "Заливка областей")
T("No GPS track", "Нет GPS-трека")
T("No elevation data", "Нет данных о высоте")
T("Reverse", "Обратно")
T("Copy .gpx files to\nc606oss/routes on the\nUSB disk", "Скопируйте .gpx в\nc606oss/routes\nна USB-диске")
T("%.1f km   %lu points\n", "%.1f км   %lu точек\n")
T("Delete ride?", "Удалить поездку?")
T("%.40s\nwill be removed from\nthe card for good.", "%.40s\nбудет удалён\nс накопителя.")
T("%d older not shown", "Скрыто старых: %d")
T("No rides recorded yet", "Поездок пока нет")
T("Wi-Fi / GPS time", "Wi-Fi / время GPS")
T("Wi-Fi name (SSID)", "Имя сети (SSID)")
T("Password", "Пароль")
T("Sync GPS time", "Обновить время GPS")
T("Starting Wi-Fi...", "Включение Wi-Fi...")
T("Already syncing; please wait.", "Синхронизация, подождите.")
T("Not enough memory.", "Недостаточно памяти.")
T("SSID: 1-32 bytes. Password: 8-63 bytes (or empty for open Wi-Fi).", "SSID: 1–32 байта. Пароль: 8–63 байта, пустой — открытая сеть.")
T("2.4 GHz Wi-Fi. Sync time to assist GPS. No EPO download.", "Wi-Fi 2,4 ГГц. Точное время для GPS. Без загрузки EPO.")
T("Connecting to Wi-Fi...", "Подключение к Wi-Fi...")
T("Wi-Fi failed. Check 2.4 GHz SSID/password and signal.", "Нет связи. Проверьте сеть 2,4 ГГц, пароль и сигнал.")
T("Wi-Fi connected. Getting UTC from NTP...", "Wi-Fi подключён. Получение времени NTP...")
T("NTP timeout. Check Internet / UDP 123. GPS time not sent.", "Нет ответа NTP. Проверьте интернет / UDP 123. Время не отправлено.")
T("Invalid network time. GPS time not sent.", "Неверное время сети. Данные GPS не отправлены.")
T("UTC synchronized. Waiting for GPS acknowledgement...", "Время получено. Ожидание подтверждения GPS...")
T("GPS accepted UTC. Wi-Fi off. Wait outdoors for a fix.", "GPS принял время. Wi-Fi выключен. Ждите позицию на улице.")
T("UTC synced, GPS did not confirm time assistance. Wi-Fi off.", "Время получено, GPS не подтвердил приём. Wi-Fi выключен.")
T("Wi-Fi/time error: %s", "Ошибка Wi-Fi/времени: %s")
T("Language could not be saved", "Не удалось сохранить язык")
T("\uf04b  START RIDE", "\uf04b  ПОЕХАЛИ")
T("\uf00c  Ride summary", "\uf00c  Итоги поездки")
T("\uf021  Reboot", "\uf021  Перезагрузка")
T("\uf2ed  Forget sensor", "\uf2ed  Забыть датчик")
T("\uf067  Add sensor", "\uf067  Добавить датчик")
T("\uf071  Reset to defaults", "\uf071  Сбросить настройки")
T("\uf287  USB storage", "\uf287  USB-накопитель")
T("\uf011  Power off", "\uf011  Выключить")
T("\uf00c  Use this route", "\uf00c  Выбрать маршрут")
T("\uf00d  Unload route", "\uf00d  Убрать маршрут")
T("\uf00c rev.", "\uf00c обр.")
T("\uf2ed  Delete", "\uf2ed  Удалить")
T("\uf124  Use as route", "\uf124  Как маршрут")
T("\uf2ed  Delete ride", "\uf2ed  Удалить поездку")
